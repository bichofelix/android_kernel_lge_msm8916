## arch/arm/mach-msm/lge/Kconfig
```kconfig
config MACH_LGE
	bool

menu "LGE Board Selection"

config MACH_MSM8916_C50_MPCS_US
        bool "MSM8916 C50_MPCS_US"
        depends on ARCH_MSM8916
        select MACH_LGE
        select LGE_ENABLE_THERMAL_CORE_CONTROL
        help
          Support for the Qualcomm MSM8916 C50 MPCS device.

config MACH_MSM8916_C50_TMO_US
        bool "MSM8916 C50_TMO_US"
        depends on ARCH_MSM8916
        select MACH_LGE
        select LGE_ENABLE_THERMAL_CORE_CONTROL
        help
          Support for the Qualcomm MSM8916 C50 TMO device.

config MACH_MSM8916_G4STYLUSN_MPCS_US
        bool "MSM8916 G4STYLUSN_MPCS_US"
        depends on ARCH_MSM8916
        select MACH_LGE
        select LGE_ENABLE_THERMAL_CORE_CONTROL
        help
          Support for the Qualcomm MSM8916 G4STYLUSN MPCS device.

config MACH_MSM8916_G4STYLUSN_TMO_US
        bool "MSM8916 G4STYLUSN_TMO_US"
        depends on ARCH_MSM8916
        select MACH_LGE
        select LGE_ENABLE_THERMAL_CORE_CONTROL
        help
          Support for the Qualcomm MSM8916 G4STYLUSN TMO device.

endmenu

config DTS_TARGET
	string "DTS target dir"
	default "msm8916-c50_mpcs_us" if MACH_MSM8916_C50_MPCS_US
	default "msm8916-c50_tmo_us" if MACH_MSM8916_C50_TMO_US
	default "msm8916-g4stylusn_mpcs_us" if MACH_MSM8916_G4STYLUSN_MPCS_US
	default "msm8916-g4stylusn_tmo_us" if MACH_MSM8916_G4STYLUSN_TMO_US

	help
	  CONFIG_DTS_TARGET should be set to support appended dts.
	  ex) CONFIG_DTS_TARGET="msm8974-g2-kr".

menu "LGE Specific Patches"

config LGE_BOOTLOADER_LOG
	tristate "Support LGE bootloader log"
	default n
	depends on MACH_LGE
	help
	  LGE bootloader log

config LGE_HANDLE_PANIC
	tristate "Support LGE Kernel Panic Handler"
	default n
	depends on MACH_LGE
	help
	  LGE Error handler

config LGE_BOOTLOADER_TIME_CHECKER
	bool "Show bootloader(LK, SBL) time"
	default n
	depends on MACH_LGE
	help
	  This shows the lk and sbl1 booting time in MSM8974.
	  If this feature is enabled, it should be check by adb shell.
	  Device Node : sys/module/lge_bootloader_time_checker/

config PRE_SELF_DIAGNOSIS
	tristate "Support LGE self diagnosis for factory"
	default n
	depends on MACH_LGE
	help
	  LGE self diagnosis

config LGE_ENABLE_THERMAL_CORE_CONTROL
        bool "Thermal Core Control"
        default n
        help
          Enable Thermal Core control to prevent hot temperature (Temporal)

config LGE_PM_CONTROL_TSENS_CRITICAL_TEMPERATURE
	bool "Support tsens critical temperature contorol"
	default n
	help
	  change tsens critical temperature for Accelerated High Temperature & Humidity Test

config LGE_FORCE_SHOW_EXTRA_REGS
	bool "Display memory around registers when displaying regs"
	default n
	help
	  always call show_extra_register_data() in __show_regs()

config LGE_USE_DEFAULT_HARD_RESET
	bool "On reboot, apply hard reset unless memory contents must be maintained"
	default n
	help
	  Nobody can guarantee stablity upon continuous warm resets.

menu "LGE Battery Profile"

config LGE_PM_BATTERY_CAPACITY_1900mAh
	bool "Support Battery Capacity : 1900mAh"
	default n
	depends on LGE_PM_BATTERY_PROFILE_DATA
	help
	  LGE battery capacity for 1900mAh

endmenu

endmenu

menu "LGE QFPROM Values"

config LGE_QFPROM_INTERFACE
	bool "Support qfprom interface"
	default n
	depends on MACH_LGE
	help
	  LGE QFPROM DRIVER.

config LGE_QFPROM_SECHASH
    string "Support qfprom sec hash"
    default 0x0
    depends on LGE_QFPROM_INTERFACE
    help
      LGE QFPROM DRIVER-SEC partition's hash value.

endmenu
```

## drivers/nfc/lge/Kconfig
```kconfig
#
# LGE Near Field Communication (NFC) devices
#

menu "LGE Near Field Communication (NFC) devices"
	depends on NFC
endmenu

config LGE_NFC
	bool "NFC Device Enabled for LGE"
	default n

config LGE_NFC_PN547_C2
	bool "PN547 C2 NFC driver"
	depends on I2C
	select CRC_CCITT
	default n
	---help---
	  Say yes if you want PN547 Near Field Communication driver.
	  This is for i2c connected version. If unsure, say N here.

	  To compile this driver as a module, choose m here. The module will
	  be called pn547.

config LGE_NFC_SET_IRQ_WAKEUP
	bool "NFC Set IRQ wakeup when NFC ON"
	default n
	---help---
	  Say yes if Set IRQ Wakeup NFC ON.
	  If unsure, say N here.

config LGE_NFC_USE_PMIC
	bool "NFC Using PMIC Clock"
	default n
	---help---
	  Say yes if you want to use PMIC Clock.
	  If use XTAL or unsure, say N here.
	  Please refer to [NFC-367] for more details.
```
